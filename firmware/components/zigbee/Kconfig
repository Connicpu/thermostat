## firmware/components/zigbee/Kconfig
```kconfig
menu "Thermostat Zigbee"
    config THERMO_ZB_LONG_POLL_MS
        int "End-device long poll interval (ms)"
        default 3000
        help
            How often the rx-off-when-idle end device polls its parent for
            buffered messages. This is the worst-case latency for a setpoint
            change from Home Assistant to land. Lower = more radio on-time.
    config THERMO_OTA_MANUFACTURER
        hex "OTA manufacturer code"
        default 0x434E
    config THERMO_OTA_IMAGE_TYPE
        hex "OTA image type"
        default 0x0301
    config THERMO_HW_VERSION
        int "Hardware version"
        default 3
endmenu
```

## firmware/main/Kconfig.projbuild
```kconfig
menu "Thermostat V3"
    config THERMO_DISPLAY_FAHRENHEIT
        bool "Show temperatures in Fahrenheit"
        default y
    config THERMO_SELF_HEAT_OFFSET_C100
        int "Fixed sensor offset in 0.01 C (self-heating compensation)"
        default 0
        range -500 500
        help
            Added to every SHT40 reading on top of the user-adjustable
            LocalTemperatureCalibration attribute. Measure against a reference
            thermometer once the board is in its case, then set this.
    config THERMO_SENSOR_PERIOD_MS
        int "Sensor read period (ms)"
        default 2000
    config THERMO_HW_WDT_ENABLE
        bool "Arm the STWD100 external watchdog"
        default y
        help
            Disable only for JTAG debugging; a breakpoint would otherwise reset the chip.
endmenu
```
